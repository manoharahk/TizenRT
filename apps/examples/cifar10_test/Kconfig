## apps/examples/cifar10_test/Kconfig
```kconfig
#
# For a description of the syntax of this configuration file,
# see kconfig-language at https://www.kernel.org/doc/Documentation/kbuild/kconfig-language.txt
#

config EXAMPLES_CIFAR10_TEST
	bool "NN(Neural Network) CIFAR-10 Test Example"
	default n
	---help---
		Enable NN(Neural Network) CIFAR-10 Test Example

config USER_ENTRYPOINT
	string
	default "cifar10_main" if ENTRY_CIFAR10_TEST
```

## apps/examples/elf/Kconfig
```kconfig
#
# For a description of the syntax of this configuration file,
# see kconfig-language at https://www.kernel.org/doc/Documentation/kbuild/kconfig-language.txt
#

config EXAMPLES_ELF
	bool "ELF Loader Example"
	default n
	select LIBC_EXECFUNCS
	depends on ELF
	---help---
		Enable the ELF loader example

if EXAMPLES_ELF

config EXAMPLES_ELF_FULLYLINKED
	bool "Fully Linked ELF application"
	default n
	depends on LIB_SYSCALL
	---help---
		Fully Linked ELF application

endif
```

## apps/examples/nn_test/Kconfig
```kconfig
#
# For a description of the syntax of this configuration file,
# see kconfig-language at https://www.kernel.org/doc/Documentation/kbuild/kconfig-language.txt
#

config EXAMPLES_NN_TEST
	bool "CMSIS-NN(Neural Network) library Test Example"
	default n
	---help---
		Enable CMSIS-NN(Neural Network) Test Example

config USER_ENTRYPOINT
	string
	default "nn_test_main" if ENTRY_NN_TEST
```

## external/CMSIS_5/Kconfig
```kconfig
#
# For a description of the syntax of this configuration file,
# see kconfig-language at https://www.kernel.org/doc/Documentation/kbuild/kconfig-language.txt
#

config CMSIS
	bool "CMSIS Library"
	default n
	---help---
		Enable ARM CMSIS Library

if CMSIS

config CMSIS_DSP
	bool "CMSIS DSP Library"
	default n
	---help---
		Enable CMSIS DSP Library Support

config CMSIS_NN
	bool "CMSIS NN Library"
	default n
	depends on CMSIS_DSP
	---help---
		Enable CMSIS NN(Neural Network) Library Support

endif # CMSIS
```
